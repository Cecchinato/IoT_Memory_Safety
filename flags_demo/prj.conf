## CMakeLists.txt
```
cmake_minimum_required(VERSION 3.20.0)
find_package(Zephyr REQUIRED HINTS $ENV{ZEPHYR_BASE})
project(flags_demo)

target_sources(app PRIVATE src/main.c)

# Which vulnerable function to execute: canary | fortify | cfi | warnings
set(DEMO "canary" CACHE STRING "canary | fortify | cfi | warnings")

if(DEMO STREQUAL "warnings")
  # The "warnings" demo reuses the canary demo code (same vulnerable
  # printk format-string bug) - see main.c
  target_compile_definitions(app PRIVATE DEMO_CANARY SHOW_FORMAT_BUG)
else()
  string(TOUPPER ${DEMO} DEMO_UPPER)
  target_compile_definitions(app PRIVATE DEMO_${DEMO_UPPER})
endif()

# switch to enable/disable hardening
option(HARDENED "Enable the hardening flag specific to the chosen demo" OFF)

# IMPORTANT: flags should be applied ONLY to the target "app" (our main.c),
# not to all of Zephyr via zephyr_compile_options().
#
# Each DEMO isolates ONLY ONE mechanism. It's not enough to "not add"
# the flags from the other three: many toolchains (e.g., Ubuntu's gcc) have
# -fstack-protector and/or -D_FORTIFY_SOURCE=2 enabled by default
# via the system spec files. So for each DEMO we explicitly disable the
# other mechanisms, so the only difference between the vuln build and the
# hard build is truly the flag under test.

# baseline: everything explicitly disabled
set(_disable_all
  -fno-stack-protector
  -U_FORTIFY_SOURCE
)
target_compile_options(app PRIVATE ${_disable_all})

if(DEMO STREQUAL "canary")

  if(HARDENED)
    message(STATUS "*** HARDENED: -fstack-protector-strong (DEMO=canary) ***")
    target_compile_options(app PRIVATE -fstack-protector-strong)
  else()
    message(STATUS "*** VULNERABLE: canary explicitly OFF (DEMO=canary) ***")
    # -fno-stack-protector is already applied by the baseline above
  endif()

elseif(DEMO STREQUAL "fortify")

  # FORTIFY_SOURCE requires at least -O1 to generate the _chk variants,
  # so -O2 is necessary in BOTH builds (hardened and vuln)
  # only to make the comparison valid: the difference remains the
  # _FORTIFY_SOURCE macro, not the optimization level.
  target_compile_options(app PRIVATE -O2)

  if(HARDENED)
    message(STATUS "*** HARDENED: -D_FORTIFY_SOURCE=2 (DEMO=fortify) ***")
    target_compile_options(app PRIVATE -D_FORTIFY_SOURCE=2)
  else()
    message(STATUS "*** VULNERABLE: FORTIFY explicitly OFF (DEMO=fortify) ***")
    # -U_FORTIFY_SOURCE is already applied by the baseline above
  endif()

elseif(DEMO STREQUAL "cfi")

  if(NOT CONFIG_ARCH_POSIX)
    message(FATAL_ERROR "DEMO=cfi requires the native_sim native_sim board")
  endif()

  if(HARDENED)
    if(NOT CMAKE_C_COMPILER_ID STREQUAL "Clang")
      message(FATAL_ERROR
        "DEMO=cfi with HARDENED=ON requires the LLVM toolchain: add "
        "-DZEPHYR_TOOLCHAIN_VARIANT=host/llvm -DCONFIG_LLVM_USE_LLD=y "
        "to the west build command")
    endif()
    message(STATUS "*** HARDENED: -fsanitize=cfi (DEMO=cfi) ***")
    target_compile_options(app PRIVATE -fsanitize=cfi -flto -fvisibility=hidden)
    target_link_options(app PRIVATE -fsanitize=cfi -flto)
  else()
    message(STATUS "*** VULNERABLE: no CFI (DEMO=cfi) ***")
    # no -fsanitize flag to disable: without -fsanitize=cfi there is
    # nothing to explicitly turn off, and it is simply absent
  endif()

elseif(DEMO STREQUAL "warnings")

  # Compile-time demo, not runtime: with HARDENED=ON the build must
  # fail due to the non-literal printk in vulnerable_copy().
  if(HARDENED)
    message(STATUS "*** HARDENED: -Wall -Wextra -Werror -Wformat-security (DEMO=warnings) ***")
    target_compile_options(app PRIVATE -Wall -Wextra -Werror -Wformat-security -Wno-unused-function)
  else()
    message(STATUS "*** VULNERABLE: warning-as-error explicitly OFF (DEMO=warnings) ***")
    target_compile_options(app PRIVATE -Wno-error -Wno-format-security)
  endif()

else()
  message(FATAL_ERROR "Unknown DEMO: '${DEMO}' (valid values: canary, fortify, cfi, warnings)")
endif()
```

## prj.conf
```kconfig
# picolibc is needed for the "_chk" functions
CONFIG_PICOLIBC=y
#CONFIG_PICOLIBC_IO_SUPPORT=y

# =n because i want to controll it with Cmake and not with kconfig
CONFIG_STACK_CANARIES=n

CONFIG_MAIN_STACK_SIZE=4096

# richiesto quando -fstack-protector-strong e' attivo: picolibc
# semina il canary chiamando getentropy(), che ha bisogno di un
# device driver di entropia compilato nel devicetree. Su native_sim
# non e' abilitato di default -> senza questo, la build HARDENED
# della demo canary fallisce in fase di link (device_dts_ord
# indefinito).
CONFIG_ENTROPY_GENERATOR=y
CONFIG_TEST_RANDOM_GENERATOR=y
```

## src/main.c
```c
#include <zephyr/kernel.h>
#include <string.h>

/* 
 * copies the *input into a buffer[16] using strcopy function.
 * strcpy is not secure an does not check for input legnth -> OOB read
 * -> return address / canary gets corrupted 
 * 
 * noinline so that the comppiler uses 2 different return and the canary can work as intended
 */
void __attribute__((noinline)) vulnerable_copy(const char *input)
{
    char buf[16];
    strcpy(buf, input);
    printk("Copied: %s\n", buf);
}

static void demo_canary(void)
{
    printk("\n=== DEMO: -fstack-protector-strong ===\n\n");/*if it is not too long, return is not corrupted and without canaries it will not crash -> silent OOB read*/
    const char *payload = "AAAAAAAAAAA_OVERFLOW";
    vulnerable_copy(payload);
    printk("If you read this, canary definitely didn't work.\n");
}

/* With _FORTIFY_SOURCE=2 enabled the compiler knows how big is 'small' (8 byte),
 * strcpy becomes __strcpy_chk and stops the runtime
 * if it gets past the limit
 */
static void demo_fortify(void)
{
    printk("\n=== DEMO: -D_FORTIFY_SOURCE=2 ===\n\n");
    char small[8];
    const char *payload = "This string is definitely longer than 8 bytes";
    strcpy(small, payload);
    printk("If you see this line, FORTIFY did NOT block the overflow: %s\n", small);
}


typedef int  (*op_int_fn)(int, int);
typedef void (*op_str_fn)(const char *);

static int  add(int a, int b) { return a + b; }
static void log_str(const char *s) { printk("[LOG]: %s\n", s); }

/* 
 * Control Flow Integrity (Clang -fsanitize=cfi) 
 * A function pointer of type op_int_fn is called via an op_str_fn type: 
 * a typical "type confusion" attack to divert the flow to 
 * an unexpected gadget/function.
 */
static void demo_cfi(void)
{
    printk("\n=== DEMO: Control Flow Integrity ===\n\n");
    void *fnptr = (void *)add;                  /* op_int_fn */
    op_str_fn wrong_type = (op_str_fn)fnptr;    /* type confusion */

    printk("Calling add() through a function pointer of the wrong type...\n");
    wrong_type("This call should never happen under CFI");
    printk("If you see this line, CFI has NOT blocked type confusion.\n");

    (void)log_str; /* silence 'unused' when the above branch does not terminate */
}


int main(void)
{
#if defined(DEMO_FORTIFY)
    demo_fortify();
#elif defined(DEMO_CFI)
    demo_cfi(); 
#else
    demo_canary();
#endif

    /*uncomment the following 2 lines to see how 
    * -Wall -Wextra -Werror -Wformat-security works
    */

    //const char *payload = "This string is definitely longer than 8 bytes";
    //printf(payload);

    return 0;
}
```

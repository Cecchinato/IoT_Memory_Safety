## CMakeLists.txt
```
cmake_minimum_required(VERSION 3.20.0)

find_package(Zephyr REQUIRED HINTS $ENV{ZEPHYR_BASE})
project(tz_demo)

target_sources(app PRIVATE src/main.c)
```

## prj.conf
```kconfig
# This is the non-secure Zephyr image. Building it against the
# mps2/an521/cpu0/ns board target pulls in TF-M as the secure world
# automatically, TF-M owns the SAU/IDAU setup and boots first.
CONFIG_BUILD_WITH_TFM=y
CONFIG_TRUSTED_EXECUTION_NONSECURE=y

CONFIG_TFM_PARTITION_PROTECTED_STORAGE=y
CONFIG_STDOUT_CONSOLE=y


CONFIG_BUILD_OUTPUT_META=y  #SPDX flag for CMake metadata
```

## src/main.c
```c
/*
 * TrustZone demo, non-secure image.
 *
 * TF-M boots first as the secure world, sets up the SAU/IDAU, then hands
 * control to this Zephyr image running non-secure. This single app stores
 * the same secret two different ways and shows what happens when
 * non-secure code tries to reach each one:
 *   1. Through the PSA Protected Storage API, which TF-M backs with
 *      secure-side storage - the correct approach.
 *   2. As a plain non-secure global, readable by anything running in
 *      this image regardless of TrustZone.
 *   3. A direct, non-secure read into a hardcoded secure-flash address,
 *      to show that the SAU fault is triggered by the address range
 *      alone, independent of what secret (if any) actually lives there.
 *
 * On the MPS2+ AN521, the same physical flash and RAM are mapped twice:
 * once at the "normal" address for NS, and once again at
 * the same offset + 0x10000000 for the secure world. That second alias
 * is what a non-secure bus transaction is not allowed to touch.
 */

#include <zephyr/kernel.h>
#include <zephyr/sys/printk.h>
#include <stdint.h>
#include <string.h>
#include <psa/protected_storage.h>

#define SECURE_FLASH_ALIAS 0x10000000u
#define KEY_UID 1
const char key[] = "Secret123!";

static void legit_key_storage(void)
{
	char retrieved[32];
	size_t out_len;
	psa_status_t status;

	printk("[GOOD] saving key via PSA Protected Storage...\n");
	status = psa_ps_set(KEY_UID, strlen(key), key, PSA_STORAGE_FLAG_NONE);
	if (status != PSA_SUCCESS) {
		printk("[GOOD] psa_ps_set failed: %d\n", status);
		return;
	}

	printk("[GOOD] reading key via PSA Protected Storage...\n");
	status = psa_ps_get(KEY_UID, 0, sizeof(retrieved) - 1, retrieved, &out_len);
	if (status != PSA_SUCCESS) {
		printk("[GOOD] psa_ps_get failed: %d\n", status);
		return;
	}
	retrieved[out_len] = '\0';

	printk("[GOOD] retrieved key: %s\n", retrieved);
}

static void untrusted_read_attempt(void)
{
	volatile uint32_t *secure_ptr = (volatile uint32_t *)SECURE_FLASH_ALIAS;

	printk("[BAD] attempting to read secure flash at %p\n",
	       (void *)secure_ptr);

	/* This line does not return. The load itself trips the SAU check
	 * and the core takes a SecureFault before the value ever reaches
	 * a register.
	 */
	uint32_t value = *secure_ptr;

	printk("[BAD] got 0x%08x (you should never see this line)\n",
	       value);
}

int main(void)
{
	printk("\n\n=== Key saved via PSA Protected Storage (secure world) ===\n");

	printk("[DBG] TrustZone is: ");
	#if defined(CONFIG_ARM_TRUSTZONE_M)
		printk("enabled\n");
	#else
		printk("disabled\n");
	#endif

	legit_key_storage();

	printk("\n=== Key kept as a plain non-secure global (no protection) ===\n");
	printk("[DBG] key lives at %p\n", (void *)key);
	printk("[untrusted code] key = ");

	for (size_t i = 0; i < sizeof(key); i++) {
		printk("%c", key[i]);
	}

	printk("\n[untrusted code] done.\n");

	printk("\n=== Direct non-secure access to a secure-flash address ===\n");
	untrusted_read_attempt();
	
	return 0;
}
```
